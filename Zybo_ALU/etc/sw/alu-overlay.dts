/dts-v1/;
/plugin/;

/ {
    fragment@0 {
        target-path = "/amba";
        __overlay__ {
            alu_axi: alu@43c00000 {
                compatible = "xlnx,alu-axi-lite-1.0";
                reg = <0x43c00000 0x1000>;
                status = "okay";
            };
        };
    };
};
